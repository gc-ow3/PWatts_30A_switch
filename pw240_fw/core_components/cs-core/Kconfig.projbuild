## pw240_fw/core_components/cs-core/Kconfig.projbuild
```kconfig
menu "IoT8020 Specific"

	config IOT8020_DEBUG
		bool "Application-level debug"
		default false
		help
			Enable application-level debug messages

endmenu
```
